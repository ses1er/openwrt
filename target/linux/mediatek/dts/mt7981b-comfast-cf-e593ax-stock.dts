// SPDX-License-Identifier: GPL-2.0-or-later OR MIT

#include "mt7981b-comfast-cf-e593ax-common.dtsi"

/ {
	model = "COMFAST CF-E593AX (Stock Layout)";
	compatible = "comfast,cf-e593ax-stock", "mediatek,mt7981";
};

&partitions {
	partition@580000 {
		label = "ubi";
		reg = <0x580000 0x4000000>;
		compatible = "linux,ubi";
	};
};
